## monitoring-app/main/Kconfig.projbuild
```kconfig
menu "Monitor App Settings"
config MONITOR_PERIOD_SEC
    int "Periodo de monitorizacion (s)"
    range 1 3600
    default 5
config BUTTON_PERIOD_SEC
    int "Periodo de muestreo del boton (s)"
    range 1 60
    default 1
config BUTTON_GPIO
    int "GPIO boton"
    range 0 48
    default 9
endmenu
```

## src/lab3/sht3c_event/main/Kconfig.projbuild
```kconfig
menu "Sensor configuration"

config SENSOR_SAMPLING_PERIOD_MS
    int "Período de muestreo del sensor (ms)"
    default 3000
    help
        Intervalo entre lecturas consecutivas del sensor de temperatura y humedad.
        Valor en milisegundos.

endmenu
```

## src/labF/aniot_sensor/components/icm_comp/Kconfig.projbuild
```kconfig
menu "ICM configuration"
        config ICM_PERTURBATION_THRESHOLD
                string "Umbral de detección de perturbación (G)"
                        default "0.4"
                        help
                            Define la sensibilidad para detectar movimientos bruscos (ej. "0.4").
                            Use un punto para los decimales. 
                            Valores menores aumentan la sensibilidad.
endmenu
```

## src/labF/aniot_sensor/components/sht3c_comp/Kconfig.projbuild
```kconfig
menu "SHT3C Configuration"
        orsource "$IDF_PATH/examples/common_components/env_caps/$IDF_TARGET/Kconfig.env_caps"
           
        config SHT3C_READ_INTERVAL
                int "Periodo de lectura del sensor (segundos)"
                range 1 3600
                default 5
                help
                    Define cada cuántos segundos se tomará una lectura de temperatura y humedad.
                    
        config SHT3C_AVG_SAMPLES
                int "Número de muestras para la media"
                range 1 100
                default 10
                help
                    Define cuántas de las últimas lecturas se utilizarán para calcular el promedio.
endmenu
```

## src/labF/default_esp-idf-lib/main/Kconfig.projbuild
```kconfig
menu "Example configuration"
    choice EXAMPLE_I2C_ADDRESS
        prompt "Select I2C address"
        default EXAMPLE_I2C_ADDRESS_GND
        help
            Select I2C address.

        config EXAMPLE_I2C_ADDRESS_GND
            bool "ICM42670_I2C_ADDR_GND (0x68)"
        config EXAMPLE_I2C_ADDRESS_VCC
            bool "ICM42670_I2C_ADDR_VCC (0x69)"
    endchoice

    config EXAMPLE_INT_INPUT_PIN
        int "Interrupt Input Pin GPIO Number"
        default 0
        help
            GPIO number for Interrupt Input Pin

    rsource "/home/zodd/Documentos/@Documentos/Master2025/2025_Master_Universitario_IoT/1-ANIOT/laboratorio/miot-aniot/src/lab4/default/managed_components/esp-idf-lib__icm42670/Kconfig.i2c"
endmenu
```
